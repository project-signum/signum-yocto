## meta-signum/conf/distro/signum.conf
```bitbake
require conf/distro/poky.conf

DISTRO = "signum"
DISTRO_NAME = "Signum Embedded Linux"
SDK_VENDOR = "-signumsdk"

MAINTAINER = "Brett Witherspoon <brett@witherspoon.engineering>"

TARGET_VENDOR = "-signum"

INIT_MANAGER = "systemd"
VIRTUAL-RUNTIME_initscripts = ""
VIRTUAL-RUNTIME_syslog = ""
VIRTUAL-RUNTIME_base-utils-syslog = ""

DISTRO_FEATURES_DEFAULT:remove = "x11 wifi bluetooth 3g nfc"
```
